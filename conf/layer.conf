## conf/machine/osd62-pm-brk.conf
```bitbake
#@TYPE: Machine
#@NAME: OSD62-PM-BRK based on AM62x SoC (A53 core)
#@DESCRIPTION: Machine configuration for Octavo Systems OSD62-PM-BRK (A53)
# Only supports bsp-ti-6-6 
# configs:
# - processor-sdk-scarthgap-10.01.10.04-config.txt
# - processor-sdk-scarthgap-chromium-10.01.10.04-config.txt

require conf/machine/include/k3.inc
require conf/machine/include/mc_k3r5.inc

SOC_FAMILY:append = ":am62xx"

MACHINE_FEATURES += "screen gpu"

SERIAL_CONSOLES = "115200;ttyS2"

require conf/machine/include/mesa-pvr.inc
PREFERRED_PROVIDER_virtual/gpudriver ?= "${BSP_ROGUE_DRIVER_PROVIDER}"

TFA_BOARD = "lite"
TFA_K3_SYSTEM_SUSPEND = "1"

OPTEEMACHINE = "k3-am62x"

UBOOT_MACHINE = "am62x_osd62x_a53_defconfig"

# Default tiboot3.bin on OSD62x is for HS-FS
IMAGE_BOOT_FILES += "tiboot3-am62x-hs-fs-osd62x.bin"

# Bitmap image tarball for early splashscreen
IMAGE_BOOT_FILES += "octavo_884x266_32bpp.bmp.gz"

KERNEL_DEVICETREE_PREFIX = " \
    ti/k3-am625 \
    ti/k3-am62x-sk \
"

KERNEL_DEVICETREE = " \
    ti/k3-am625-beagleplay-csi2-ov5640.dtbo \
    ti/k3-am625-beagleplay-csi2-tevi-ov5640.dtbo \
    ti/k3-am625-beagleplay.dtb \
    ti/k3-am625-phyboard-lyra-1-4-ghz-opp.dtbo \
    ti/k3-am625-phyboard-lyra-rdk.dtb \
    ti/k3-am625-sk.dtb \
    ti/k3-am625-verdin-nonwifi-dahlia.dtb \
    ti/k3-am625-verdin-nonwifi-dev.dtb \
    ti/k3-am625-verdin-nonwifi-mallow.dtb \
    ti/k3-am625-verdin-nonwifi-yavia.dtb \
    ti/k3-am625-verdin-wifi-dahlia.dtb \
    ti/k3-am625-verdin-wifi-dev.dtb \
    ti/k3-am625-verdin-wifi-mallow.dtb \
    ti/k3-am625-verdin-wifi-yavia.dtb \
    ti/k3-am62x-sk-csi2-imx219.dtbo \
    ti/k3-am62x-sk-csi2-ov5640.dtbo \
    ti/k3-am62x-sk-csi2-tevi-ov5640.dtbo \
    ti/k3-am62x-sk-hdmi-audio.dtbo \
    ti/k3-am625-osd625-brk-microtips-mf101hie-panel.dtbo \
    ti/k3-am625-osd625-brk-csi2-ov5640.dtbo \
"
```
